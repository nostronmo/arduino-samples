## first-nuttx/Kconfig
```kconfig
source "$APPSDIR/projects/wificonnect/Kconfig"
source "$APPSDIR/projects/webdata/Kconfig"
# source "$APPSDIR/projects/nothing/Kconfig"
```

## first-nuttx/wificonnect/Kconfig
```kconfig
config WIFICONNECT_APP
    tristate "Wi-Fi Connection App"
    default y
    ---help---
        Enable the Wi-Fi connection initializer application.
```
